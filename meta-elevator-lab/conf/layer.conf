## meta-elevator-lab/conf/layer.conf
```bitbake
BBPATH .= ":${LAYERDIR}"
BBFILES += "${LAYERDIR}/recipes-*/*/*.bb ${LAYERDIR}/recipes-*/*/*.bbappend"
BBFILE_COLLECTIONS += "elevatorlab"
BBFILE_PATTERN_elevatorlab = "^${LAYERDIR}/"
BBFILE_PRIORITY_elevatorlab = "7"
LAYERSERIES_COMPAT_elevatorlab = "scarthgap"
LAYERDEPENDS_elevatorlab = "core"
```
